## CMakeLists.txt
```
cmake_minimum_required(VERSION 3.20.0)

# Allow local board extensions
list(APPEND BOARD_ROOT ${CMAKE_CURRENT_SOURCE_DIR})

set(SHIELD waveshare_epaper_gdew042t2)

find_package(Zephyr)
project(timechime_remote)


FILE(GLOB app_sources src/*.c)
target_sources(app PRIVATE ${app_sources})
```

## prj.conf
```kconfig
CONFIG_LV_Z_MEM_POOL_SIZE=8192
CONFIG_MAIN_STACK_SIZE=4096

CONFIG_DISPLAY=y

CONFIG_LVGL=y
CONFIG_LV_USE_LABEL=y
CONFIG_LV_FONT_MONTSERRAT_14=y
```

## boards/extensions/feather_m0_lora/adafruit_feather_m0_lora.overlay
```dts
/*
 * Map Arduino R3 + arduino_spi onto feather m0 lora
 *
 *   Arduino R3 | Feather pin | SAMD21 GPIO | Shield signal
 *   -----------+-------------+-------------+--------------
 *   D4         | D5          | PA15        | Unused SDHC CS
 *   D7         | D6          | PA20        | Busy
 *   D8         | A3          | PA4         | Reset
 *   D9         | D9          | PA7         | DC
 *   D10        | D10         | PA18        | E-paper CS
 *   MOSI       | D23         | PB10        | sercom4 MOSI
 *   SCK        | D24         | PB11        | sercom4 SCK
 */

#include <zephyr/dt-bindings/gpio/arduino-header-r3.h>

/ {
	arduino_header: connector {
		compatible = "arduino-header-r3";
		#gpio-cells = <2>;
		gpio-map-mask = <0xffffffff 0xffffffc0>;
		gpio-map-pass-thru = <0 0x3f>;
		gpio-map =
			<ARDUINO_HEADER_R3_D4  0 &porta 15 0>,
			<ARDUINO_HEADER_R3_D7  0 &porta 20 0>,
			<ARDUINO_HEADER_R3_D8  0 &porta  4 0>,
			<ARDUINO_HEADER_R3_D9  0 &porta  7 0>,
			<ARDUINO_HEADER_R3_D10 0 &porta 18 0>;
	};
};

arduino_spi: &sercom4 {};
```

## src/main.c
```c
#include <zephyr/kernel.h>

#include "screen_ui.h"

int main(void)
{
	timechime_screen_init();
	timechime_screen_ui_clear();

	return 0;
}
```

## src/screen_ui.c
```c
#include <zephyr/device.h>
#include <zephyr/devicetree.h>
#include <zephyr/drivers/display.h>
#include <zephyr/drivers/gpio.h>
#include <lvgl.h>
#include <zephyr/kernel.h>

#include "screen_ui.h"
#include "sprites.h"

static const lv_image_dsc_t *sprites[NUM_TIMECHIME_SPRITES];

// MIPI DBI SPI config sets cs_is_gpio=false (no cs-gpios on the MIPI DBI node),
// so the SAM0 SPI driver never asserts CS.
static const struct gpio_dt_spec epaper_cs =
	GPIO_DT_SPEC_GET_BY_IDX(DT_NODELABEL(arduino_spi), cs_gpios, 0);

bool timechime_screen_init()
{
	sprites[TIMECHIME_SPRITE_ARROW_UP] = &sprite_up;
	sprites[TIMECHIME_SPRITE_ARROW_DOWN] = &sprite_down;
	sprites[TIMECHIME_SPRITE_PLUS] = &sprite_plus;
	sprites[TIMECHIME_SPRITE_BELL] = &sprite_bell;
	sprites[TIMECHIME_SPRITE_GEAR] = &sprite_gear;
	sprites[TIMECHIME_SPRITE_TRASH] = &sprite_trash;
	sprites[TIMECHIME_SPRITE_CONFIRM] = &sprite_confirm;

	gpio_pin_configure_dt(&epaper_cs, GPIO_OUTPUT_ACTIVE);

	const struct device *display_dev = DEVICE_DT_GET(DT_CHOSEN(zephyr_display));
	if (!device_is_ready(display_dev)) {
		return false;
	}

	return true;
}

void timechime_screen_ui_clear()
{
	lv_obj_t *base_layer = lv_screen_active();
	lv_obj_set_style_bg_color(base_layer, lv_color_white(), 0);
	lv_obj_set_style_bg_opa(base_layer, LV_OPA_COVER, 0);

	lv_coord_t screen_w = lv_display_get_horizontal_resolution(NULL);
	lv_coord_t screen_h = lv_display_get_vertical_resolution(NULL);

	// Horizontal line 3/4 of the way down
	lv_obj_t *h_line = lv_obj_create(base_layer);
	lv_obj_set_style_bg_color(h_line, lv_color_black(), 0);
	lv_obj_set_style_bg_opa(h_line, LV_OPA_COVER, 0);
	lv_obj_set_style_border_width(h_line, 0, 0);
	lv_obj_set_size(h_line, screen_w, 2);
	lv_obj_set_pos(h_line, 0, screen_h * 3 / 4);

	// Three vertical lines 1/4 apart, connecting horizontal line to bottom
	lv_coord_t v_line_top = screen_h * 3 / 4;
	lv_coord_t v_line_height = screen_h - v_line_top;
	for (int i = 1; i <= 3; i++) {
		lv_obj_t *v_line = lv_obj_create(base_layer);
		lv_obj_set_style_bg_color(v_line, lv_color_black(), 0);
		lv_obj_set_style_bg_opa(v_line, LV_OPA_COVER, 0);
		lv_obj_set_style_border_width(v_line, 0, 0);
		lv_obj_set_size(v_line, 2, v_line_height);
		lv_obj_set_pos(v_line, screen_w * i / 4, v_line_top);
	}
}

void timechime_screen_draw_button_indicator(int button, timechime_sprite_t sprite)
{
	if (button < 0 || button >= 4 || (unsigned int)sprite >= NUM_TIMECHIME_SPRITES) {
		return;
	}

	lv_coord_t screen_w = lv_display_get_horizontal_resolution(NULL);
	lv_coord_t screen_h = lv_display_get_vertical_resolution(NULL);
	lv_coord_t section_w = screen_w / 4;
	lv_coord_t section_h = screen_h / 4;

	int32_t img_w = sprites[sprite]->header.w;
	int32_t img_h = sprites[sprite]->header.h;

	lv_obj_t *img = lv_image_create(lv_screen_active());
	lv_image_set_src(img, sprites[sprite]);
	lv_obj_set_pos(img, button * section_w + (section_w - img_w) / 2,
		       screen_h * 3 / 4 + (section_h - img_h) / 2);
}

void timechime_screen_draw_button_indicator_set(timechime_sprite_t sprites[4])
{
	for (int i = 0; i < 4; i++) {
		timechime_screen_draw_button_indicator(i, sprites[i]);
	}
}

static bool screen_refresh_done;

static void on_refr_finish(lv_event_t *e)
{
	screen_refresh_done = true;
}

void timechime_screen_wait(void)
{
	screen_refresh_done = false;
	lv_display_add_event_cb(lv_display_get_default(), on_refr_finish, LV_EVENT_FLUSH_FINISH,
				NULL);

	while (!screen_refresh_done) {
		lv_timer_handler();
		k_sleep(K_MSEC(10));
	}
}
```

## src/screen_ui.h
```c
#ifndef TIMECHIME_SCREEN_UI_H
#define TIMECHIME_SCREEN_UI_H

#include <stdbool.h>

// The set of available sprites to display.
typedef enum {
	TIMECHIME_SPRITE_ARROW_UP,
	TIMECHIME_SPRITE_ARROW_DOWN,
	TIMECHIME_SPRITE_PLUS,
	TIMECHIME_SPRITE_BELL,
	TIMECHIME_SPRITE_GEAR,
	TIMECHIME_SPRITE_TRASH,
	TIMECHIME_SPRITE_CONFIRM,
	NUM_TIMECHIME_SPRITES
} timechime_sprite_t;

// Initialize screen hardware and LVGL and confirm device is available.
bool timechime_screen_init();

// Wait for display to update.
void timechime_screen_wait();

// Clear the screen and add base UI lines.
void timechime_screen_ui_clear();

// Draw sprite for a specified button indicator.
void timechime_screen_draw_button_indicator(int button, timechime_sprite_t sprite);

// Draw a specific set of button indicators.
void timechime_screen_draw_button_indicator_set(timechime_sprite_t sprites[4]);

#endif
```

## src/sprites.c
```c
#include <lvgl.h>

#include "sprites.h"

// I1 format: 2×lv_color32_t palette (blue,green,red,alpha) then pixel rows MSB-first.
// palette[0]=white background, palette[1]=black foreground; bit 1=arrow body.
static const uint8_t sprite_up_data[] = {
	0xFF, 0xFF, 0xFF, 0xFF, 0x00, 0x00, 0x00, 0xFF, // palette: white, black
	0x00, 0x01, 0x80, 0x00,                         // row  0: tip (2px)
	0x00, 0x03, 0xC0, 0x00,                         // row  1
	0x00, 0x07, 0xE0, 0x00,                         // row  2
	0x00, 0x0F, 0xF0, 0x00,                         // row  3
	0x00, 0x1F, 0xF8, 0x00,                         // row  4
	0x00, 0x3F, 0xFC, 0x00,                         // row  5
	0x00, 0x7F, 0xFE, 0x00,                         // row  6
	0x00, 0xFF, 0xFF, 0x00,                         // row  7
	0x01, 0xFF, 0xFF, 0x80,                         // row  8
	0x03, 0xFF, 0xFF, 0xC0,                         // row  9
	0x07, 0xFF, 0xFF, 0xE0,                         // row 10
	0x0F, 0xFF, 0xFF, 0xF0,                         // row 11
	0x1F, 0xFF, 0xFF, 0xF8,                         // row 12
	0x3F, 0xFF, 0xFF, 0xFC,                         // row 13
	0x7F, 0xFF, 0xFF, 0xFE,                         // row 14
	0xFF, 0xFF, 0xFF, 0xFF,                         // row 15: base (32px)
	0x00, 0x0F, 0xF0, 0x00,                         // row 16: stem start (8px)
	0x00, 0x0F, 0xF0, 0x00,                         // row 17
	0x00, 0x0F, 0xF0, 0x00,                         // row 18
	0x00, 0x0F, 0xF0, 0x00,                         // row 19
	0x00, 0x0F, 0xF0, 0x00,                         // row 20
	0x00, 0x0F, 0xF0, 0x00,                         // row 21
	0x00, 0x0F, 0xF0, 0x00,                         // row 22
	0x00, 0x0F, 0xF0, 0x00,                         // row 23
	0x00, 0x0F, 0xF0, 0x00,                         // row 24
	0x00, 0x0F, 0xF0, 0x00,                         // row 25
	0x00, 0x0F, 0xF0, 0x00,                         // row 26
	0x00, 0x0F, 0xF0, 0x00,                         // row 27
	0x00, 0x0F, 0xF0, 0x00,                         // row 28
	0x00, 0x0F, 0xF0, 0x00,                         // row 29
	0x00, 0x0F, 0xF0, 0x00,                         // row 30
	0x00, 0x0F, 0xF0, 0x00,                         // row 31
};

static const uint8_t sprite_down_data[] = {
	0xFF, 0xFF, 0xFF, 0xFF, 0x00, 0x00, 0x00, 0xFF, // palette: white, black
	0x00, 0x0F, 0xF0, 0x00,                         // row  0: stem (8px)
	0x00, 0x0F, 0xF0, 0x00,                         // row  1
	0x00, 0x0F, 0xF0, 0x00,                         // row  2
	0x00, 0x0F, 0xF0, 0x00,                         // row  3
	0x00, 0x0F, 0xF0, 0x00,                         // row  4
	0x00, 0x0F, 0xF0, 0x00,                         // row  5
	0x00, 0x0F, 0xF0, 0x00,                         // row  6
	0x00, 0x0F, 0xF0, 0x00,                         // row  7
	0x00, 0x0F, 0xF0, 0x00,                         // row  8
	0x00, 0x0F, 0xF0, 0x00,                         // row  9
	0x00, 0x0F, 0xF0, 0x00,                         // row 10
	0x00, 0x0F, 0xF0, 0x00,                         // row 11
	0x00, 0x0F, 0xF0, 0x00,                         // row 12
	0x00, 0x0F, 0xF0, 0x00,                         // row 13
	0x00, 0x0F, 0xF0, 0x00,                         // row 14
	0x00, 0x0F, 0xF0, 0x00,                         // row 15: stem end
	0xFF, 0xFF, 0xFF, 0xFF,                         // row 16: base (32px)
	0x7F, 0xFF, 0xFF, 0xFE,                         // row 17
	0x3F, 0xFF, 0xFF, 0xFC,                         // row 18
	0x1F, 0xFF, 0xFF, 0xF8,                         // row 19
	0x0F, 0xFF, 0xFF, 0xF0,                         // row 20
	0x07, 0xFF, 0xFF, 0xE0,                         // row 21
	0x03, 0xFF, 0xFF, 0xC0,                         // row 22
	0x01, 0xFF, 0xFF, 0x80,                         // row 23
	0x00, 0xFF, 0xFF, 0x00,                         // row 24
	0x00, 0x7F, 0xFE, 0x00,                         // row 25
	0x00, 0x3F, 0xFC, 0x00,                         // row 26
	0x00, 0x1F, 0xF8, 0x00,                         // row 27
	0x00, 0x0F, 0xF0, 0x00,                         // row 28
	0x00, 0x07, 0xE0, 0x00,                         // row 29
	0x00, 0x03, 0xC0, 0x00,                         // row 30
	0x00, 0x01, 0x80, 0x00,                         // row 31: tip (2px)
};

const lv_image_dsc_t sprite_up = {
	.header = {.magic = LV_IMAGE_HEADER_MAGIC,
		   .cf = LV_COLOR_FORMAT_I1,
		   .flags = 0,
		   .w = 32,
		   .h = 32,
		   .stride = 4},
	.data_size = sizeof(sprite_up_data),
	.data = sprite_up_data,
};

const lv_image_dsc_t sprite_down = {
	.header = {.magic = LV_IMAGE_HEADER_MAGIC,
		   .cf = LV_COLOR_FORMAT_I1,
		   .flags = 0,
		   .w = 32,
		   .h = 32,
		   .stride = 4},
	.data_size = sizeof(sprite_down_data),
	.data = sprite_down_data,
};

static const uint8_t sprite_plus_data[] = {
	0xFF, 0xFF, 0xFF, 0xFF, 0x00, 0x00, 0x00, 0xFF, // palette: white, black
	0x00, 0x0F, 0xF0, 0x00,                         // row  0: vertical bar (8px)
	0x00, 0x0F, 0xF0, 0x00,                         // row  1
	0x00, 0x0F, 0xF0, 0x00,                         // row  2
	0x00, 0x0F, 0xF0, 0x00,                         // row  3
	0x00, 0x0F, 0xF0, 0x00,                         // row  4
	0x00, 0x0F, 0xF0, 0x00,                         // row  5
	0x00, 0x0F, 0xF0, 0x00,                         // row  6
	0x00, 0x0F, 0xF0, 0x00,                         // row  7
	0x00, 0x0F, 0xF0, 0x00,                         // row  8
	0x00, 0x0F, 0xF0, 0x00,                         // row  9
	0x00, 0x0F, 0xF0, 0x00,                         // row 10
	0x00, 0x0F, 0xF0, 0x00,                         // row 11
	0xFF, 0xFF, 0xFF, 0xFF,                         // row 12: horizontal bar (32px)
	0xFF, 0xFF, 0xFF, 0xFF,                         // row 13
	0xFF, 0xFF, 0xFF, 0xFF,                         // row 14
	0xFF, 0xFF, 0xFF, 0xFF,                         // row 15
	0xFF, 0xFF, 0xFF, 0xFF,                         // row 16
	0xFF, 0xFF, 0xFF, 0xFF,                         // row 17
	0xFF, 0xFF, 0xFF, 0xFF,                         // row 18
	0xFF, 0xFF, 0xFF, 0xFF,                         // row 19
	0x00, 0x0F, 0xF0, 0x00,                         // row 20: vertical bar (8px)
	0x00, 0x0F, 0xF0, 0x00,                         // row 21
	0x00, 0x0F, 0xF0, 0x00,                         // row 22
	0x00, 0x0F, 0xF0, 0x00,                         // row 23
	0x00, 0x0F, 0xF0, 0x00,                         // row 24
	0x00, 0x0F, 0xF0, 0x00,                         // row 25
	0x00, 0x0F, 0xF0, 0x00,                         // row 26
	0x00, 0x0F, 0xF0, 0x00,                         // row 27
	0x00, 0x0F, 0xF0, 0x00,                         // row 28
	0x00, 0x0F, 0xF0, 0x00,                         // row 29
	0x00, 0x0F, 0xF0, 0x00,                         // row 30
	0x00, 0x0F, 0xF0, 0x00,                         // row 31
};

static const uint8_t sprite_bell_data[] = {
	0xFF, 0xFF, 0xFF, 0xFF, 0x00, 0x00, 0x00, 0xFF, // palette: white, black
	0x00, 0x00, 0x00, 0x00,                         // row  0: empty
	0x00, 0x03, 0xC0, 0x00,                         // row  1: hanger ring (4px)
	0x00, 0x07, 0xE0, 0x00,                         // row  2: hanger ring (6px)
	0x00, 0x03, 0xC0, 0x00,                         // row  3: hanger ring (4px)
	0x00, 0x01, 0x80, 0x00,                         // row  4: stem (2px)
	0x00, 0x01, 0x80, 0x00,                         // row  5
	0x00, 0x01, 0x80, 0x00,                         // row  6
	0x00, 0x07, 0xE0, 0x00,                         // row  7: dome start (6px)
	0x00, 0x1F, 0xF8, 0x00,                         // row  8: dome (10px)
	0x00, 0x7F, 0xFE, 0x00,                         // row  9: dome (14px)
	0x01, 0xFF, 0xFF, 0x80,                         // row 10: dome (18px)
	0x03, 0xFF, 0xFF, 0xC0,                         // row 11: dome (20px)
	0x07, 0xFF, 0xFF, 0xE0,                         // row 12: dome (22px)
	0x0F, 0xFF, 0xFF, 0xF0,                         // row 13: dome (24px)
	0x0F, 0xFF, 0xFF, 0xF0,                         // row 14
	0x0F, 0xFF, 0xFF, 0xF0,                         // row 15
	0x0F, 0xFF, 0xFF, 0xF0,                         // row 16
	0x0F, 0xFF, 0xFF, 0xF0,                         // row 17
	0x0F, 0xFF, 0xFF, 0xF0,                         // row 18
	0x0F, 0xFF, 0xFF, 0xF0,                         // row 19
	0x0F, 0xFF, 0xFF, 0xF0,                         // row 20
	0x1F, 0xFF, 0xFF, 0xF8,                         // row 21: flare (26px)
	0x3F, 0xFF, 0xFF, 0xFC,                         // row 22: flare (28px)
	0x7F, 0xFF, 0xFF, 0xFE,                         // row 23: flare (30px)
	0xFF, 0xFF, 0xFF, 0xFF,                         // row 24: rim (32px)
	0xFF, 0xFF, 0xFF, 0xFF,                         // row 25: rim
	0x00, 0x00, 0x00, 0x00,                         // row 26: empty
	0x00, 0x03, 0xC0, 0x00,                         // row 27: clapper (4px)
	0x00, 0x03, 0xC0, 0x00,                         // row 28
	0x00, 0x01, 0x80, 0x00,                         // row 29: clapper tip (2px)
	0x00, 0x00, 0x00, 0x00,                         // row 30: empty
	0x00, 0x00, 0x00, 0x00,                         // row 31
};

// 8 teeth at N/S/E/W and four diagonal positions; center hub hole
static const uint8_t sprite_gear_data[] = {
	0xFF, 0xFF, 0xFF, 0xFF, 0x00, 0x00, 0x00, 0xFF, // palette: white, black
	0x00, 0x0F, 0xF0, 0x00,                         // row  0: N tooth (8px)
	0x00, 0x0F, 0xF0, 0x00,                         // row  1
	0x00, 0x0F, 0xF0, 0x00,                         // row  2
	0x00, 0x0F, 0xF0, 0x00,                         // row  3
	0x0F, 0x0F, 0xF0, 0xF0,                         // row  4: diagonal teeth + body
	0x0F, 0x3F, 0xFC, 0xF0,                         // row  5
	0x0F, 0xFF, 0xFF, 0xF0,                         // row  6
	0x0F, 0xFF, 0xFF, 0xF0,                         // row  7
	0x03, 0xFF, 0xFF, 0x80,                         // row  8: body (19px)
	0x07, 0xFF, 0xFF, 0xC0,                         // row  9: body (21px)
	0x07, 0xFF, 0xFF, 0xE0,                         // row 10: body (22px)
	0x0F, 0xFF, 0xFF, 0xF0,                         // row 11: body (24px)
	0xFF, 0xFC, 0x3F, 0xFF,                         // row 12: W/E teeth, center hole (4px)
	0xFF, 0xF8, 0x1F, 0xFF,                         // row 13: W/E teeth, center hole (6px)
	0xFF, 0xF0, 0x0F, 0xFF,                         // row 14: W/E teeth, center hole (8px)
	0xFF, 0xF0, 0x0F, 0xFF,                         // row 15
	0xFF, 0xF0, 0x0F, 0xFF,                         // row 16
	0xFF, 0xF0, 0x0F, 0xFF,                         // row 17
	0xFF, 0xF8, 0x1F, 0xFF,                         // row 18: W/E teeth, center hole (6px)
	0xFF, 0xFC, 0x3F, 0xFF,                         // row 19: W/E teeth, center hole (4px)
	0x0F, 0xFF, 0xFF, 0xF0,                         // row 20: body (24px)
	0x07, 0xFF, 0xFF, 0xE0,                         // row 21: body (22px)
	0x07, 0xFF, 0xFF, 0xC0,                         // row 22: body (21px)
	0x03, 0xFF, 0xFF, 0x80,                         // row 23: body (19px)
	0x0F, 0xFF, 0xFF, 0xF0,                         // row 24: diagonal teeth + body
	0x0F, 0xFF, 0xFF, 0xF0,                         // row 25
	0x0F, 0x3F, 0xFC, 0xF0,                         // row 26
	0x0F, 0x0F, 0xF0, 0xF0,                         // row 27
	0x00, 0x0F, 0xF0, 0x00,                         // row 28: S tooth (8px)
	0x00, 0x0F, 0xF0, 0x00,                         // row 29
	0x00, 0x0F, 0xF0, 0x00,                         // row 30
	0x00, 0x0F, 0xF0, 0x00,                         // row 31
};

const lv_image_dsc_t sprite_plus = {
	.header = {.magic = LV_IMAGE_HEADER_MAGIC,
		   .cf = LV_COLOR_FORMAT_I1,
		   .flags = 0,
		   .w = 32,
		   .h = 32,
		   .stride = 4},
	.data_size = sizeof(sprite_plus_data),
	.data = sprite_plus_data,
};

const lv_image_dsc_t sprite_bell = {
	.header = {.magic = LV_IMAGE_HEADER_MAGIC,
		   .cf = LV_COLOR_FORMAT_I1,
		   .flags = 0,
		   .w = 32,
		   .h = 32,
		   .stride = 4},
	.data_size = sizeof(sprite_bell_data),
	.data = sprite_bell_data,
};

const lv_image_dsc_t sprite_gear = {
	.header = {.magic = LV_IMAGE_HEADER_MAGIC,
		   .cf = LV_COLOR_FORMAT_I1,
		   .flags = 0,
		   .w = 32,
		   .h = 32,
		   .stride = 4},
	.data_size = sizeof(sprite_gear_data),
	.data = sprite_gear_data,
};

static const uint8_t sprite_trash_data[] = {
	0xFF, 0xFF, 0xFF, 0xFF, 0x00, 0x00, 0x00, 0xFF, // palette: white, black
	0x00, 0x0F, 0xF0, 0x00,                         // row  0: (8px)
	0x00, 0x08, 0x10, 0x00,                         // row  1: (2px)
	0x03, 0xFF, 0xFF, 0xC0,                         // row  2: (20px)
	0x03, 0xFF, 0xFF, 0xC0,                         // row  3: (20px)
	0x00, 0x00, 0x00, 0x00,                         // row  4: empty
	0x03, 0xFF, 0xFF, 0xC0,                         // row  5: (20px)
	0x03, 0xFF, 0xFF, 0xC0,                         // row  6: (20px)
	0x03, 0xFF, 0xFF, 0xC0,                         // row  7: (20px)
	0x03, 0x66, 0x66, 0xC0,                         // row  8: (12px)
	0x03, 0x66, 0x66, 0xC0,                         // row  9: (12px)
	0x03, 0x66, 0x66, 0xC0,                         // row 10: (12px)
	0x03, 0x66, 0x66, 0xC0,                         // row 11: (12px)
	0x03, 0x66, 0x66, 0xC0,                         // row 12: (12px)
	0x03, 0x66, 0x66, 0xC0,                         // row 13: (12px)
	0x03, 0x66, 0x66, 0xC0,                         // row 14: (12px)
	0x03, 0x66, 0x66, 0xC0,                         // row 15: (12px)
	0x03, 0x66, 0x66, 0xC0,                         // row 16: (12px)
	0x03, 0x66, 0x66, 0xC0,                         // row 17: (12px)
	0x03, 0x66, 0x66, 0xC0,                         // row 18: (12px)
	0x03, 0x66, 0x66, 0xC0,                         // row 19: (12px)
	0x03, 0x66, 0x66, 0xC0,                         // row 20: (12px)
	0x03, 0x66, 0x66, 0xC0,                         // row 21: (12px)
	0x03, 0x66, 0x66, 0xC0,                         // row 22: (12px)
	0x03, 0x66, 0x66, 0xC0,                         // row 23: (12px)
	0x03, 0x66, 0x66, 0xC0,                         // row 24: (12px)
	0x03, 0x66, 0x66, 0xC0,                         // row 25: (12px)
	0x03, 0x66, 0x66, 0xC0,                         // row 26: (12px)
	0x03, 0x66, 0x66, 0xC0,                         // row 27: (12px)
	0x03, 0x66, 0x66, 0xC0,                         // row 28: (12px)
	0x03, 0xFF, 0xFF, 0xC0,                         // row 29: (20px)
	0x03, 0xFF, 0xFF, 0xC0,                         // row 30: (20px)
	0x03, 0xFF, 0xFF, 0xC0,                         // row 31: (20px)
};

const lv_image_dsc_t sprite_trash = {
	.header = {.magic = LV_IMAGE_HEADER_MAGIC,
		   .cf = LV_COLOR_FORMAT_I1,
		   .flags = 0,
		   .w = 32,
		   .h = 32,
		   .stride = 4},
	.data_size = sizeof(sprite_trash_data),
	.data = sprite_trash_data,
};
```

## src/sprites.h
```c
#ifndef TIMECHIME_SPRITES_H
#define TIMECHIME_SPRITES_H

#include <lvgl.h>

extern const lv_image_dsc_t sprite_up;
extern const lv_image_dsc_t sprite_down;
extern const lv_image_dsc_t sprite_plus;
extern const lv_image_dsc_t sprite_bell;
extern const lv_image_dsc_t sprite_gear;
extern const lv_image_dsc_t sprite_trash;
extern const lv_image_dsc_t sprite_confirm;

#endif
```
